## conf/bblayers.conf.sample
```bitbake
# POKY_BBLAYERS_CONF_VERSION is increased each time build/conf/bblayers.conf
# changes incompatibly
POKY_BBLAYERS_CONF_VERSION = "2"

BBPATH = "${TOPDIR}"
BBFILES ?= ""

BBLAYERS ?= " \
  ##OEROOT##/../poky/meta \
  ##OEROOT##/../poky/meta-poky \
  ##OEROOT##/../poky/meta-yocto-bsp \
  ##OEROOT##/../poky/meta-rockchip \
  ##OEROOT##/../poky/meta-openembedded/meta-oe \
  ##OEROOT##/../poky/meta-openembedded/meta-networking \
  ##OEROOT##/../poky/meta-openembedded/meta-python \
  ##OEROOT##/../poky/meta-canexp \
  "
```

## conf/layer.conf
```bitbake
# We have a conf and classes directory, add to BBPATH
BBPATH .= ":${LAYERDIR}"

# We have recipes-* directories, add to BBFILES
BBFILES += "${LAYERDIR}/recipes-*/*/*.bb \
            ${LAYERDIR}/recipes-*/*/*.bbappend"

BBFILE_COLLECTIONS += "meta-canexp"
BBFILE_PATTERN_meta-canexp = "^${LAYERDIR}/"
BBFILE_PRIORITY_meta-canexp = "10"

LAYERDEPENDS_meta-canexp = "core"
LAYERSERIES_COMPAT_meta-canexp = "dunfell"
```
